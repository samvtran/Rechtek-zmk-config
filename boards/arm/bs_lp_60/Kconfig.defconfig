## boards/arm/bs_lp_60/Kconfig.defconfig
```kconfig
# Copyright (c) 2024 Cole Smith
# SPDX-License-Identifier: MIT

if BOARD_BS_LP_60

config BOARD
	default "bs_lp_60"

config ZMK_KEYBOARD_NAME
	default "bs_lp_60"

if USB

config USB_NRFX
	default y

config USB_DEVICE_STACK
	default y

endif # USB

config BT_CTLR
	default BT

config ZMK_BLE
	default y

config ZMK_USB
	default y

endif # BOARD_BS_LP_60
```

## config/boards/arm/bs_lp_60/Kconfig.board
```kconfig
# bs_lp_60 board configuration

# Copyright (c) 2024 Cole Smith
# SPDX-License-Identifier: MIT

config BOARD_BS_LP_60
	bool "bs_lp_60"
	depends on SOC_NRF52840_QIAA
```
